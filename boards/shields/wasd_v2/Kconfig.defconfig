## boards/shields/wasd_v2/Kconfig.defconfig
```kconfig
# Copyright (c) 2020 The ZMK Contributors
# SPDX-License-Identifier: MIT

if SHIELD_WASD_V2

config ZMK_KEYBOARD_NAME
    default "WASD v2"

endif
```

## boards/shields/wasd_v2/Kconfig.shield
```kconfig
# Copyright (c) 2020 The ZMK Contributors
# SPDX-License-Identifier: MIT

config SHIELD_WASD_V2
    def_bool $(shields_list_contains,wasd_v2)
```
